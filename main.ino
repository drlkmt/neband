#include <Wire.h>
#include <Adafruit_GFX.h>
#include <Adafruit_SSD1306.h>
#include <Fonts/FreeSerif9pt7b.h>
#define SCREEN_WIDTH 128 // OLED display width, in pixels
#define SCREEN_HEIGHT 64 // OLED display height, in pixels
// Declaration for an SSD1306 display connected to I2C (SDA, SCL pins)
Adafruit_SSD1306 display(SCREEN_WIDTH, SCREEN_HEIGHT, &Wire, -1);

#define CALIBRATELOOPCX 10
#define STEPIS 26
#define STEPISNOT 29
#define STEPISH 7
const int adxl345 = 0x53; // I2C адрес ADXL345

static const PROGMEM uint8_t neband[1024] = {
    0x00, 0x00, 0x00, 0x00, 0x00, 0x00, 0x00, 0x00, 0x00, 0x00, 0x00, 0x00, 0x00, 0x00, 0x00, 0x00, 
    0x00, 0x00, 0x00, 0x00, 0x00, 0x00, 0x00, 0x00, 0x00, 0x00, 0x00, 0x00, 0x00, 0x00, 0x00, 0x00, 
    0x00, 0x00, 0x00, 0x00, 0x00, 0x00, 0x00, 0x00, 0x00, 0x00, 0x00, 0x00, 0x00, 0x00, 0x00, 0x00, 
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    0x00, 0x00, 0x00, 0x00, 0x10, 0x00, 0x00, 0x21, 0x00, 0x00, 0x00, 0x00, 0x00, 0x00, 0x04, 0x10
};

static const PROGMEM uint8_t ricardo[1024] = {
    0xff, 0x00, 0x07, 0x00, 0x00, 0x00, 0x7f, 0xff, 0xff, 0xff, 0xff, 0xff, 0xff, 0xff, 0xff, 0xff, 
    0xfe, 0x00, 0x02, 0x00, 0x00, 0x00, 0x7f, 0xff, 0xff, 0xff, 0xff, 0xff, 0xff, 0xff, 0xff, 0xff, 
    0xfe, 0x00, 0x00, 0x00, 0x80, 0x00, 0x7f, 0xff, 0xff, 0xff, 0xff, 0xff, 0xff, 0xff, 0xff, 0x7f, 
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    0xff, 0xff, 0x00, 0x00, 0x1f, 0xfe, 0x00, 0x00, 0xff, 0xff, 0xff, 0x03, 0xff, 0xff, 0xff, 0xff
};

int x,y,z,xavg=0,yavg=0,zavg=0, steps=0, vector,vectorb;
bool flag = 0;
byte xyz[6];
byte c;
int i, j;
void setup() {
  Serial.begin(9600);
  Wire.begin();

  pinMode(3, INPUT_PULLUP);
  attachInterrupt(1, btnIsr, FALLING);
  
  // запишем адрес регистра DEVID
  Wire.beginTransmission(adxl345);
  Wire.write(byte(0x00));
  Wire.endTransmission();
    
  if(!display.begin(SSD1306_SWITCHCAPVCC, 0x3C)) { 
    Serial.println("SSD1306 allocation failed");
    for(;;);
  }
  display.setFont(&FreeSerif9pt7b);
  display.setTextSize(1);             
  display.setTextColor(WHITE); 
  display.clearDisplay();
  //display.drawBitmap(0, 0, ricardo, 128, 64, 1);
  display.drawBitmap(0, 0, neband, 128, 64, 1);    //раскоментируй что то одно. Превьюшка
  display.display();

  // переведём акселерометр в режим измерений
  Wire.beginTransmission(adxl345);
  Wire.write(byte(0x2D));
  Wire.write(byte(0x08));
  Wire.endTransmission();
  calibrate();
  delay(5000);
}

void btnIsr() {
  steps = 0;
}

void loop() {
  // запишем адрес начала данных по осям X, Y и Z:
  Wire.beginTransmission(adxl345);
  Wire.write(byte(0x32));
  Wire.endTransmission();

  // прочитаем 6 байтов значений XYZ:
  i = 0;
  xyz[6];
  Wire.requestFrom(adxl345, 6);
  while (Wire.available()) {
    c = Wire.read();
    xyz[i] = c;
    i++;
  }
  // посчитаем и отобразим значения X, Y, Z:
  x = word(xyz[1], xyz[0]) - xavg;
  y = word(xyz[3], xyz[2]) - yavg;
  z = word(xyz[5], xyz[4]) - zavg;

  //vector = sqrt(x * x + y * y + z * z); //агрессия подсчета шагов, лучше с y, которая ниже
  vector = sqrt(y * y);
  vectorb = (vector + vectorb) / 2;
    if (vectorb < STEPIS && flag == 0)
    {
      steps = steps + 1;
      flag = 1;
    }
    else if (vectorb >= STEPIS && vectorb <= STEPIS - STEPISH && flag == 1)
    {
      // Don't Count
    }
    if (vectorb > STEPISNOT && flag == 1)
    {
      flag = 0;
    }
  /*Serial.print(STEPIS);
  Serial.print(",");
  Serial.print(STEPIS - STEPISH);
  Serial.print(",");
  Serial.print(STEPISNOT);
  Serial.print(",");
  Serial.println(vectorb); */
  display.clearDisplay();
  display.setCursor(0,15);
  display.println("-=NeBand!=-");   
  display.println("Your steps");      
  display.println(steps);
  display.display();
  //delay(100);
  calibrate();
}

void calibrate()
{
  Wire.beginTransmission(adxl345);
  Wire.write(byte(0x32));
  Wire.endTransmission();

  // прочитаем 6 байтов значений XYZ:
  i = 0;
  xyz[6];
  Wire.requestFrom(adxl345, 6);
  while (Wire.available()) {
    c = Wire.read();
    xyz[i] = c;
    i++;
  }
  for(i = 0; i < CALIBRATELOOPCX; i++)
  {

    xavg += word(xyz[1], xyz[0]);
    yavg += word(xyz[3], xyz[2]);
    zavg += word(xyz[5], xyz[4]);
    
  }
    xavg /= CALIBRATELOOPCX;
    yavg /= CALIBRATELOOPCX;
    zavg /= CALIBRATELOOPCX;
}
